//ARDUBRO808
//By JetJaguar
//May 18, 2017
//Copyright (C) 2017 WakeBakeLake. All rights reserved.

#include <Arduboy2.h>
#include <ArduboyTones.h>

Arduboy2 arduboy;
ArduboyTones sound(arduboy.audio.enabled);

#define GAME_INTRO                0
#define GAME                1

byte gameProgress = 0;

//Graphics
const unsigned char titlescreen[] PROGMEM  = {0xec, 0x34, 0x2c, 0x34, 0x2c, 0x34, 0x2c, 0x34, 0x2c, 0x34, 0x2c, 0x34, 0x2c,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 0xaa, 
};
const unsigned char rested[] PROGMEM  = {0x00, 0x00, 0x00, 0x00, 0x00, 0x00, 0x00, 0x00, 0x00, 0x00, 0x00, 0xfc, 0x4,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 0x00, 
};
const unsigned char ABUTTON[] PROGMEM  = {0x00, 0x00, 0x00, 0x00, 0x00, 0x00, 0x00, 0x00, 0x00, 0x00, 0x00, 0xfc, 0x4,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 0x00, 
};
const unsigned char BBUTTON[] PROGMEM  = {0x00, 0x00, 0x00, 0x00, 0x00, 0x00, 0x00, 0x00, 0x00, 0x00, 0x00, 0xfc, 0x4,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 0x00, 
};
const unsigned char UPBUTTON[] PROGMEM  = {0x00, 0x00, 0x00, 0x00, 0x00, 0x00, 0x00, 0x00, 0x00, 0x00, 0x00, 0xfc, 0x4,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 0x00, 
};
const unsigned char DOWNBUTTON[] PROGMEM  = {0x00, 0x00, 0x00, 0x00, 0x00, 0x00, 0x00, 0x00, 0x00, 0x00, 0x00, 0xfc, 0x4,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 0x00, 
};
const unsigned char LBUTTON[] PROGMEM  = {0x00, 0x00, 0x00, 0x00, 0x00, 0x00, 0x00, 0x00, 0x00, 0x00, 0x00, 0xfc, 0x4,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 0x00, 
};
const unsigned char RBUTTON[] PROGMEM  = {0x00, 0x00, 0x00, 0x00, 0x00, 0x00, 0x00, 0x00, 0x00, 0x00, 0x00, 0xfc, 0x4,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 0x00, 
};

//Sounds?
const uint16_t note[] PROGMEM = {
  NOTE_FS1,107, NOTE_C4,500, TONES_END
};


void setup() {
  arduboy.begin();
  arduboy.setFrameRate(60);
}

void loop() {
  if (!(arduboy.nextFrame()))
    return;
  arduboy.clear();

 switch (gameProgress)
  {
case GAME_INTRO:
      arduboy.drawBitmap(0, 0, titlescreen, 128, 64, WHITE);
      arduboy.setCursor(15, 56);
      arduboy.print("by @JetJaguar3030");
      arduboy.display();
      arduboy.delayShort(3000);
      gameProgress = GAME;
      break;

case GAME:
  if(arduboy.pressed(UP_BUTTON)) {
   arduboy.drawBitmap(0, 0, UPBUTTON, 128, 64, WHITE); 
   sound.tones(note);
  }
  else if(arduboy.pressed(DOWN_BUTTON)){
  arduboy.drawBitmap(0, 0, DOWNBUTTON, 128, 64, WHITE); 
  sound.tones(note);
  }
  else if(arduboy.pressed(RIGHT_BUTTON)){
   arduboy.drawBitmap(0, 0, RBUTTON, 128, 64, WHITE); 
   sound.tones(note);
  }
  else if(arduboy.pressed(LEFT_BUTTON)){
   arduboy.drawBitmap(0, 0, LBUTTON, 128, 64, WHITE); 
   sound.tones(note);
  }
  else if(arduboy.pressed(A_BUTTON)){
  arduboy.drawBitmap(0, 0, ABUTTON, 128, 64, WHITE); 
  sound.tones(note);
  }
  else if(arduboy.pressed(B_BUTTON)){
  arduboy.drawBitmap(0, 0, BBUTTON, 128, 64, WHITE); 
  sound.tones(note);
  }else{
  arduboy.drawBitmap(0, 0, rested, 128, 64, WHITE); 
  sound.tones(note);
  }
  break;
  }
   
  arduboy.display();

}
